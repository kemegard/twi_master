## Kconfig
```kconfig
# SPDX-License-Identifier: Apache-2.0

config GPIO_CONNECTIVITY_TEST
	bool "GPIO connectivity test mode"
	help
	  When enabled, compile src/gpio_test_main.c instead of the I2C
	  master application.  Used to verify physical wiring before I2C
	  testing.

source "Kconfig.zephyr"
```

## build/Kconfig/boards/Kconfig.sysbuild
```kconfig
# Load Sysbuild board Kconfig descriptions.
osource "D:/work/ncs/v3.2.0/zephyr/boards/nordic/nrf54l15dk/Kconfig.sysbuild"
```
